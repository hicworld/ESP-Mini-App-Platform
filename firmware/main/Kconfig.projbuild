## firmware/main/Kconfig.projbuild
```kconfig
menu "ESP Mini Platform"

config PLATFORM_INTERACTION_V02
    bool "Interaction V0.2 AS312 and mechanical keys"
    default n
    help
        Enable only with the verified Interaction V0.2 board attached.
        Keys are active-low GPIO inputs per the September 10 schematic.

config PLATFORM_INTERACTION_LEFT
    bool "Interaction board in left slot (otherwise right)"
    depends on PLATFORM_INTERACTION_V02
    default n

config PLATFORM_OTA_TEST_FAIL_BOOT
    bool "Force rollback when an OTA image is pending verification"
    default n
    help
        Test-only fault injection. A newly installed OTA image marks itself
        invalid and reboots so the bootloader rollback path can be verified.
        Never enable this option in a production firmware build.

endmenu
```

## firmware/sdkconfig.defaults
```kconfig
CONFIG_IDF_TARGET="esp32s31"
CONFIG_COMPILER_OPTIMIZATION_PERF=y
CONFIG_FREERTOS_HZ=1000
CONFIG_PARTITION_TABLE_CUSTOM=y
CONFIG_PARTITION_TABLE_CUSTOM_FILENAME="partitions.csv"
CONFIG_ESPTOOLPY_FLASHSIZE_16MB=y
CONFIG_BOOTLOADER_APP_ROLLBACK_ENABLE=y
CONFIG_SPIRAM=y
CONFIG_SPIRAM_SPEED_250M=y
CONFIG_SPIRAM_XIP_FROM_PSRAM=y
CONFIG_SPIRAM_MEMTEST=n
CONFIG_BSP_CO5300_ENABLE_TE=y
CONFIG_LV_CONF_SKIP=y
CONFIG_LV_COLOR_DEPTH_16=y
CONFIG_LV_OS_FREERTOS=y
CONFIG_LV_DEF_REFR_PERIOD=30
CONFIG_LV_DPI_DEF=60
CONFIG_LV_USE_CLIB_MALLOC=y
CONFIG_LV_USE_CLIB_STRING=y
CONFIG_LV_USE_CLIB_SPRINTF=y
CONFIG_LV_FONT_MONTSERRAT_20=y
CONFIG_TINYUSB_CDC_ENABLED=y
CONFIG_MBEDTLS_CERTIFICATE_BUNDLE=y
CONFIG_MBEDTLS_CERTIFICATE_BUNDLE_CROSS_SIGNED_VERIFY=y
CONFIG_ESP_MAIN_TASK_STACK_SIZE=12288
CONFIG_SPIFFS_OBJ_NAME_LEN=96
CONFIG_NAND_FLASH_ENABLE_BDL=n
```
